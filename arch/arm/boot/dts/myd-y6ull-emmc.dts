/*
 * Copyright (C) 2016 Freescale Semiconductor, Inc.
 *
 * This program is free software; you can redistribute it and/or modify
 * it under the terms of the GNU General Public License version 2 as
 * published by the Free Software Foundation.
 */

/dts-v1/;

#include "myb-imx6ull-14x14-base.dts"

&gpmi {
	status = "disabled";
};

&usdhc1 {
	status = "okay";
};

&usdhc2 {
    pinctrl-names = "default";
    pinctrl-0 = <&pinctrl_usdhc2_8bit>;
    bus-width = <8>;
    non-removable;
    status = "okay";
};

