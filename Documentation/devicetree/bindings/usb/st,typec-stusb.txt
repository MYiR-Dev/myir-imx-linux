## Documentation/devicetree/bindings/usb/st,typec-stusb.txt
```
STMicroelectronics STUSB Type-C Controller family

Required properties:
 - compatible: should be "st,stusb1600".
 - reg: I2C slave address of the device.

Optional properties:
 - vdd-supply: main power supply [4.1V;22V].
 - vsys-supply: low power supply [3.0V;5.5V].
 - vconn-supply: power supply [2.7;5.5V] used to supply VConn on CC pin in
   source or dual power role.
 - interrupts: interrupt specifier triggered by ALERT# signal.
   Please refer to ../interrupt-controller/interrupt.txt
 - pinctrl state named "default" may be defined to configure pin for #ALERT
   signal

USB-C connector attached to STUSB Type-C port controller can be described in
an optional connector sub-node. Refer to ../connector/usb-connector.txt.
In case role switch can be used, an optional port sub-node can be added. Refer
to ../graph.txt.

Example :

	typec: stusb1600@28 {
		compatible = "st,stusb1600";
		reg = <0x28>;
		vdd-supply = <&vbus_drd>;
		vsys-supply = <&vdd_usb>;
		interrupts = <11 IRQ_TYPE_EDGE_FALLING>;
		interrupt-parent = <&gpioi>;
		pinctrl-names = "default";
		pinctrl-0 = <&stusb1600_pins_a>;

		usb_con: connector {
			compatible = "usb-c-connector";
			label = "USB-C";
			power-role = "dual";
			power-opmode = "1.5A";
			data-role = "dual";

			port {
				con_usbotg_hs_ep: endpoint {
					remote-endpoint = <&usbotg_hs_ep>;
				};
			};
		};
	};
```

## drivers/staging/rtl8733bu/Kconfig
```kconfig
config RTL8733BU
	depends on MMC
	tristate "Realtek 8733B USB WiFi"
	help
	  Realtek RTL8733BU chipset driver
	  802.11ac USB wireless network adapter
```
