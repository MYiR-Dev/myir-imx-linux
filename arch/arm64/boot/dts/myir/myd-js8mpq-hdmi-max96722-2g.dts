// SPDX-License-Identifier: (GPL-2.0+ OR MIT)
/*
 * MYD-JS8MPQ 2GB DDR variant with native HDMI and a MAX96722 on the
 * physical CSI1 connector.
 *
 * The GMSL adapter reuses the OV5640 CSI1 input on this carrier:
 *
 *   GMSL cameras -> MAX96722 -> mipi_csi_1 -> isi_1
 *
 * This follows the NVP6324/N4 single-output model used by the 6.18 BSP.  All
 * four ALI360-YH links are initialized, but the MAX96722 exposes only the
 * selected camera on VC0.  The active input is switched at runtime through
 * the MAX96722 driver's active_camera attribute.
 */

#include "myd-js8mpq-hdmi-max96722.dts"
#include "myd-js8mpq-2g-memory.dtsi"

/ {
	model = "MYIR MYD-JS8MPQ 4G board (HDMI + CSI1 MAX96722)";

};
