// SPDX-License-Identifier: GPL-2.0
/*
 * MYD-Y6ULX (i.MX6ULL) baseboard + eMMC variant
 */

/dts-v1/;

#include "imx6ull.dtsi"
#include "myd-y6ull-base.dtsi"
/ {
	model = "MYiR MYD-Y6ULX i.MX6ULL (eMMC)";
	compatible = "myir,myd-y6ulx", "fsl,imx6ull";
};
&ecspi1 {
	status = "disabled";
};

&usdhc2 {
    pinctrl-names = "default";
    pinctrl-0 = <&pinctrl_usdhc2_8bit>;
    bus-width = <8>;
    non-removable;
    status = "okay";
};